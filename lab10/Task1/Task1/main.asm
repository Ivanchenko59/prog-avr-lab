;
; Task1.asm
;
; Created: 18.11.2021 22:59:11
; Author : ivanc
;


cli ; заборона переривань"
	; DDR"
	ldi r16, 1 << PB0 ; завантаження константи "0000 0001" в регіст r16"
	out DDRB, r16 ; перенесення з регістру r16 у I/O регістр DDRB"

	ldi r16, (1 << PC1) | (1 << PC2) ; завантаження константи "0000 0101" в регіст r16"
	out DDRC, r16 ; перенесення з регістру r16 у I/O регістр DDRC"

	ldi r16, (1 << PD3) | (1 << PD7) ; завантаження константи "0011 0000" в регіст r16"
	out DDRD, r16 ; перенесення з регістру r16 у I/O регістр DDRD"

	; PORT"
	ldi r16, 0b00010000 ; завантаження константи "0001 0000" в регіст r16"
	out PORTB, r16 ; перенесення з регістру r16 у I/O регістр PORTB"

	ldi r16, 0b00010001; завантаження константи "0001 0001" в регіст r16"
	out PORTC, r16 ; перенесення з регістру r16 у I/O регістр PORTC"

	ldi r16, 0b01000100 ; завантаження константи "0100 0100" в регіст r16"
	out PORTD, r16 ; перенесення з регістру r16 у I/O регістр PORTD"

	sei ; дозвіл переривань"

start:
	cli ; заборона переривань"
	; на Arduino Uno світлодіод на pin 13, а кнопка на pin 12"
	in r16, PINB ; пересилання з I/O регістра PINB у регістр r16"
	sbrc r16, PB4 ; пропустити наступну команду, якщо 4й біт в регістрі r16 очищен (дорівнює 0)"
	sbi PORTB, PB0 ; встановлення 5го біту в I/O регістрі PORTB в 1"
	nop ; після пропуску команди, потрапляєм сюди (тут нічого не відбувається)"
	sbrs r16, PB4 ; пропустити наступну команду, якщо 4й біт в регістрі r16 встановлен (дорівнює 1)"
	cbi PORTB, PB0 ; скидання 5го біту в I/O регістрі PORTB в 0"
	nop ; після пропуску команди, потрапляєм сюди (тут нічого не відбувається)"

	; на Arduino Uno світлодіод на A1, а кнопка на A0"
	in r16, PINC ; пересилання з I/O регістра PINC у регістр r16"
	sbrc r16, PC0 ; пропустити наступну команду, якщо 0й біт в регістрі r16 очищен (дорівнює 0)"
	sbi PORTC, PC1 ; встановлення 1го біту в I/O регістрі PORTC в 1"
	nop ; після пропуску команди, потрапляєм сюди (тут нічого не відбувається)"
	sbrs r16, PC0 ; пропустити наступну команду, якщо 0й біт в регістрі r16 встановлен (дорівнює 1)"
	cbi PORTC, PC1 ; скидання 1го біту в I/O регістрі PORTC в 0"
	nop ; після пропуску команди, потрапляєм сюди (тут нічого не відбувається)"

	; на Arduino Uno світлодіод на A5, а кнопка на A4"
	in r16, PINC ; пересилання з I/O регістра PINC у регістр r16"
	sbrc r16, PC4 ; пропустити наступну команду, якщо 4й біт в регістрі r16 очищен (дорівнює 0)"
	sbi PORTC, PC2 ; встановлення 5го біту в I/O регістрі PORTC в 1"
	nop ; після пропуску команди, потрапляєм сюди (тут нічого не відбувається)"
	sbrs r16, PC4 ; пропустити наступну команду, якщо 4й біт в регістрі r16 встановлен (дорівнює 1)"
	cbi PORTC, PC2 ; скидання 5го біту в I/O регістрі PORTC в 0"
	nop ; після пропуску команди, потрапляєм сюди (тут нічого не відбувається)"

	; на Arduino Uno світлодіод на pin 3, а кнопка на pin 2"
	in r16, PIND ; пересилання з I/O регістра PIND у регістр r16"
	sbrc r16, PD2 ; пропустити наступну команду, якщо 2й біт в регістрі r16 очищен (дорівнює 0)"
	sbi PORTD, PD3 ; встановлення 3го біту в I/O регістрі PORTD в 1"
	nop ; після пропуску команди, потрапляєм сюди (тут нічого не відбувається)"
	sbrs r16, PD2 ; пропустити наступну команду, якщо 2й біт в регістрі r16 встановлен (дорівнює 1)"
	cbi PORTD, PD3 ; скидання 3го біту в I/O регістрі PORTD в 0"
	nop ; після пропуску команди, потрапляєм сюди (тут нічого не відбувається)"

	; на Arduino Uno світлодіод на pin 7, а кнопка на pin 6"
	in r16, PIND ; пересилання з I/O регістра PIND у регістр r16"
	sbrc r16, PD6 ; пропустити наступну команду, якщо 6й біт в регістрі r16 очищен (дорівнює 0)"
	sbi PORTD, PD7 ; встановлення 7го біту в I/O регістрі PORTD в 1"
	nop ; після пропуску команди, потрапляєм сюди (тут нічого не відбувається)"
	sbrs r16, PD6 ; пропустити наступну команду, якщо 6й біт в регістрі r16 встановлен (дорівнює 1)"
	cbi PORTD, PD7 ; скидання 7го біту в I/O регістрі PORTD в 0"
	nop ; після пропуску команди, потрапляєм сюди (тут нічого не відбувається)"

	sei ; дозвіл переривань"
	rjmp start
